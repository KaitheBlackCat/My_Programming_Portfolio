
#include "U8glib.h"
#include "RTClib.h"

#define CLOCK_INTERRUPT_PIN 2

U8GLIB_SSD1306_128X64 u8g(U8G_I2C_OPT_DEV_0|U8G_I2C_OPT_NO_ACK|U8G_I2C_OPT_FAST);
RTC_DS3231 rtc;

char daysOfTheWeek[7][12] = {"SUNDAY", "MONDAY", "TUESDAY", "WEDNESDAY", "THURSDAY", "FRIDAY", "SATURDAY"};

volatile bool timeRefresh = false;

const u8g_fntpgm_uint8_t M42_6[229] U8G_FONT_SECTION("M42_6") = {
  0,16,12,0,252,8,0,0,0,0,48,57,0,8,0,8,
  0,10,8,16,11,0,0,127,128,255,192,225,192,225,192,225,
  192,225,192,255,192,127,128,5,8,8,6,0,0,56,120,248,
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  192,255,192,255,128};

const u8g_fntpgm_uint8_t M42_12[559] U8G_FONT_SECTION("M42_12") = {
  0,32,24,0,248,16,0,0,0,0,48,58,0,16,0,16,
  0,20,16,48,22,0,0,63,255,192,63,255,192,255,255,240,
  255,255,240,252,3,240,252,3,240,252,3,240,252,3,240,252,
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  6,0,2,240,240,240,240,0,0,0,0,240,240,240,240};

const u8g_fntpgm_uint8_t Superstar12[695] U8G_FONT_SECTION("Superstar12") = {
  0,21,21,254,251,9,1,49,0,0,46,90,0,11,255,9,
  0,2,2,2,3,0,0,192,192,9,9,18,10,0,0,1,
  128,3,128,7,0,14,0,28,0,56,0,112,0,224,0,192,
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  14,28,56,112,224,254,254};

const u8g_fntpgm_uint8_t Superstar19[398] U8G_FONT_SECTION("Superstar19") = {
  0,33,32,253,248,14,0,0,0,0,45,57,0,14,0,14,
  0,9,3,6,11,0,5,255,128,255,128,255,128,3,3,3,
  5,0,0,224,224,224,14,14,28,16,0,0,0,28,0,124,
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  255,224,63,224,0,224,0,224,63,224,63,128,63,128};


void setup() {

    Serial.begin(9600);

    rtc.begin();

    /*
    if (rtc.lostPower()) {
        //Serial.println("RTC lost power, let's set the time!");
        // When time needs to be set on a new device, or after a power loss, the
        // following line sets the RTC to the date & time this sketch was compiled
        rtc.adjust(DateTime(F(__DATE__), F(__TIME__)));
        // This line sets the RTC with an explicit date & time, for example to set
        // January 21, 2014 at 3am you would call:
        // rtc.adjust(DateTime(2014, 1, 21, 3, 0, 0));
    }
    */

    rtc.disable32K();


    if ( u8g.getMode() == U8G_MODE_R3G3B2 ) {
        u8g.setColorIndex(255);     // white
    }
    else if ( u8g.getMode() == U8G_MODE_GRAY2BIT ) {
        u8g.setColorIndex(3);         // max intensity
    }
    else if ( u8g.getMode() == U8G_MODE_BW ) {
        u8g.setColorIndex(1);         // pixel on
    }
    else if ( u8g.getMode() == U8G_MODE_HICOLOR ) {
        u8g.setHiColorByRGB(255,255,255);
    }

    u8g.setFontPosBottom();

}


void loop() {

    DateTime now = rtc.now();

    char currentTime[] = "hh:mm";
    char currentDate[] = "YYYY.MM.DD";
    char currentSecond[] = "ss";

    now.toString(currentTime);
    now.toString(currentDate);
    now.toString(currentSecond);

    Serial.print(now.year(), DEC);
    Serial.print('/');
    Serial.print(now.month(), DEC);
    Serial.print('/');
    Serial.print(now.day(), DEC);
    Serial.print(" (");
    Serial.print(daysOfTheWeek[now.dayOfTheWeek()]);
    Serial.print(") ");
    Serial.print(now.hour(), DEC);
    Serial.print(':');
    Serial.print(now.minute(), DEC);
    Serial.print(':');
    Serial.print(now.second(), DEC);
    Serial.println();

    Serial.print("currentTime : "); Serial.print(currentTime); Serial.print("/");
    Serial.print("currentDate : "); Serial.print(currentDate); Serial.print("/");
    Serial.print("currentSecond : "); Serial.println(currentSecond);
    


    // picture loop
    u8g.firstPage();  
    do {
        //u8g.setFont(M42_6);
        //u8g.setFont(M42_12);
        //u8g.setFont(Superstar19);
        u8g.setFont(Superstar12);
        u8g.drawStr( 30, 20, currentDate);
        u8g.setFont(M42_12);
        u8g.drawStr( 11, 48, currentTime);
        u8g.setFont(M42_6);
        u8g.drawStr( 96, 48, currentSecond);
    } while( u8g.nextPage() );
  
    // rebuild the picture after some delay
    delay(50);

}
