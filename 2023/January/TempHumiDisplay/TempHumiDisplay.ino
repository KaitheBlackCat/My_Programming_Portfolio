#include "U8glib.h"
#include "DHT.h"

#define DHTPIN 2
#define DHTTYPE DHT22

U8GLIB_NHD27OLED_BW u8g(13, 11, 10, 9);
DHT dht(DHTPIN, DHTTYPE);

// ' Battery ', 32x16px
const unsigned char epd_bitmap__Battery_ [] PROGMEM = {
    0x40, 0x00, 0x00, 0x02, 0x40, 0x00, 0x00, 0x02, 0x40, 0x00, 0x00, 0x02, 0x20, 0x00, 0x00, 0x04, 
    0x10, 0x00, 0x00, 0x08, 0x08, 0x00, 0x00, 0x10, 0x06, 0x00, 0x00, 0x60, 0x01, 0x80, 0x01, 0x80, 
    0x00, 0x60, 0x06, 0x00, 0x00, 0x1f, 0xf8, 0x00, 0x00, 0x00, 0x00, 0x00, 0x00, 0x00, 0x00, 0x00, 
    0x00, 0x00, 0x00, 0x00, 0x00, 0x00, 0x00, 0x00, 0x00, 0x00, 0x00, 0x00, 0x00, 0x00, 0x00, 0x00
};
// ' Battery Mark', 8x9px
const unsigned char epd_bitmap__Battery_Mark [] PROGMEM = {
    0x00, 0x18, 0x30, 0x60, 0x7e, 0x06, 0x0c, 0x18, 0x00
};

// ' Humidity Gauge', 56x56px
const unsigned char epd_bitmap__Humidity_Gauge [] PROGMEM = {
    0x00, 0x00, 0x01, 0xff, 0x00, 0x00, 0x00, 0x00, 0x00, 0x1e, 0x00, 0xf0, 0x00, 0x00, 0x00, 0x00, 
    0x60, 0x10, 0x0c, 0x00, 0x00, 0x00, 0x01, 0x80, 0x10, 0x03, 0x00, 0x00, 0x00, 0x06, 0x00, 0x10, 
    0x00, 0xc0, 0x00, 0x00, 0x19, 0x00, 0x10, 0x01, 0x30, 0x00, 0x00, 0x20, 0x80, 0x00, 0x02, 0x08, 
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    0x00, 0x00, 0x00, 0x00, 0x00, 0x00, 0x00, 0x00
};
// ' My Logo', 16x7px
const unsigned char epd_bitmap__My_Logo [] PROGMEM = {
    0x02, 0x40, 0x06, 0x60, 0x0f, 0xf0, 0x1a, 0x58, 0x1e, 0x78, 0x0f, 0xf0, 0x00, 0x00
};

// ' Temperature Gauge', 56x56px
const unsigned char epd_bitmap__Temperature_Gauge [] PROGMEM = {
    0x00, 0x00, 0x01, 0xff, 0x00, 0x00, 0x00, 0x00, 0x00, 0x1e, 0x00, 0xf0, 0x00, 0x00, 0x00, 0x00, 
    0x60, 0x10, 0x0c, 0x00, 0x00, 0x00, 0x01, 0x80, 0x10, 0x03, 0x00, 0x00, 0x00, 0x06, 0x00, 0x10, 
    0x00, 0xc0, 0x00, 0x00, 0x18, 0x00, 0x10, 0x00, 0x30, 0x00, 0x00, 0x20, 0x00, 0x00, 0x00, 0x08, 
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    0x00, 0x00, 0x00, 0x00, 0x00, 0x00, 0x00, 0x00
};

int pixelOff = 2;
int strLength = 0;

// {Temperature, Humidity}

int niddle_angle_deg[2] = {45, 45};

int niddle_start_x[2] = {};
int niddle_start_y[2] = {};
int niddle_end_x[2] = {};
int niddle_end_y[2] = {};
int niddle_center_x[2] = {31, 96};
int niddle_center_y[2] = {35, 35};
int niddle_radius_big = 22;
int niddle_radius_small = 9;
int niddle_offset_x[2] = {};
int niddle_offset_y[2] = {};

float humidity = 0.0;
float temperature = 0.0;

char humidityChar[4];
char temperatureChar[5];


void setup() {
  Serial.begin(9600);
  u8g.setColorIndex(1);
  u8g.setFont(u8g_font_fixed_v0);
  u8g.setFontPosTop();

  dht.begin();
}

void loop() {

  delay(1000);

  humidity = dht.readHumidity();
  temperature = dht.readTemperature();

  dtostrf(humidity, 4, 1, humidityChar);
  dtostrf(temperature, 4, 1, temperatureChar);

  niddle_angle_deg[0] = map(temperature, -40.0, 80.0, 45, 270+45);
  niddle_angle_deg[1] = map(humidity, 0.0, 100.0, 45, 270+45);

  for(int i = 0; i<2; i++) {
    niddle_start_x[i] = niddle_radius_big * -sin(radians(niddle_angle_deg[i])) + niddle_center_x[i];
    niddle_start_y[i] = niddle_radius_big * cos(radians(niddle_angle_deg[i])) + niddle_center_y[i];

    niddle_end_x[i] = niddle_radius_small * -sin(radians(niddle_angle_deg[i] + 180)) + niddle_center_x[i];
    niddle_end_y[i] = niddle_radius_small * cos(radians(niddle_angle_deg[i] + 180)) + niddle_center_y[i];

    if ((niddle_angle_deg[i] > 45 && niddle_angle_deg[i] < 135) || (niddle_angle_deg[i] > 225 && niddle_angle_deg[i] < 135)) {
      niddle_offset_x[i] = 0;
      niddle_offset_y[i] = 1;
    } else {
      niddle_offset_x[i] = 1;
      niddle_offset_y[i] = 0;
    }
  }
  
  u8g.firstPage();

  while(u8g.nextPage()) {
    u8g.drawBitmapP(56, 57, 16/8, 7, epd_bitmap__My_Logo);

    u8g.drawBitmapP(48, 4 + pixelOff, 32/8, 16, epd_bitmap__Battery_);
    u8g.drawBitmapP(60, 14 + pixelOff, 8/8, 9, epd_bitmap__Battery_Mark);

    u8g.drawBitmapP(4, 7 + pixelOff, 56/8, 56, epd_bitmap__Temperature_Gauge);
    u8g.drawBitmapP(69, 7 + pixelOff, 56/8, 56, epd_bitmap__Humidity_Gauge);

    for(int i = 0; i<2; i++) {
      u8g.drawLine(niddle_start_x[i], niddle_start_y[i], niddle_end_x[i], niddle_end_y[i]);
      u8g.drawLine(niddle_start_x[i] + niddle_offset_x[i], niddle_start_y[i] + niddle_offset_y[i], niddle_end_x[i] + niddle_offset_x[i], niddle_end_y[i] + niddle_offset_y[i]);
    }
    
    u8g.setColorIndex(0);
    u8g.drawDisc(31, 35 + pixelOff, 3);
    u8g.drawDisc(96, 35 + pixelOff, 3);
    u8g.setColorIndex(1);

    u8g.drawCircle(31, 35 + pixelOff, 2);
    u8g.drawCircle(96, 35 + pixelOff, 2);

    // Set The Temperature value fisrt.

    strLength = u8g.getStrWidth(temperatureChar);
    u8g.drawStr(31 - (int)((strLength-1)/2), 52, temperatureChar);

    // Set The Humidity value second

    strLength = u8g.getStrWidth(humidityChar);
    u8g.drawStr(96 - (int)((strLength-1)/2), 52, humidityChar);
    
  }

}
